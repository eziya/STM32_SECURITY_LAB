/*###ICF### Set of symbols used in SE and SB_SFU projects ****/

/* Slots must be aligned on 4096 bytes (0x1000) */

/* Active slot #1 : 424 Kbytes */
/* Header located outside download area for anti-rollback mechanism
   ==> In case of wireless stack update the download area from
   __ICFEDIT_SLOT_Active_1_start__ to __ICFEDIT_SLOT_Active_1_end__ is erased
*/
define exported symbol  __ICFEDIT_SLOT_Active_1_header__= 0x08015000;
define exported symbol  __ICFEDIT_SLOT_Active_1_start__ = 0x08016000;
define exported symbol  __ICFEDIT_SLOT_Active_1_end__   = 0x0807FFFF;

/* Slots not configured */
define exported symbol  __ICFEDIT_SLOT_Active_2_header__= 0x00000000;
define exported symbol  __ICFEDIT_SLOT_Active_2_start__ = 0x00000000;
define exported symbol  __ICFEDIT_SLOT_Active_2_end__   = 0x00000000;
define exported symbol  __ICFEDIT_SLOT_Active_3_header__= 0x00000000;
define exported symbol  __ICFEDIT_SLOT_Active_3_start__ = 0x00000000;
define exported symbol  __ICFEDIT_SLOT_Active_3_end__   = 0x00000000;
