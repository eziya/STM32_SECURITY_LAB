/*###ICF### Set of symbols used in SE and SB_SFU projects ****/

/* Slots must be aligned on 4096 bytes (0x1000) */

/* swap (8 Kbytes) */
define exported symbol  __ICFEDIT_SWAP_start__  = 0x08016000;
define exported symbol  __ICFEDIT_SWAP_end__    = 0x08017FFF;

/* Active slot #1 (208 Kbytes) */
define exported symbol  __ICFEDIT_SLOT_Active_1_start__ = 0x08018000;
define exported symbol  __ICFEDIT_SLOT_Active_1_end__   = 0x0804BFFF;
define exported symbol  __ICFEDIT_SLOT_Active_1_header__= __ICFEDIT_SLOT_Active_1_start__;

/* Dwl slot #1 (208 KBytes) */
define exported symbol  __ICFEDIT_SLOT_Dwl_1_start__= 0x0804C000;
define exported symbol  __ICFEDIT_SLOT_Dwl_1_end__  = 0x0807FFFF;

/* Slots not configured */
define exported symbol  __ICFEDIT_SLOT_Active_2_header__= 0x00000000;
define exported symbol  __ICFEDIT_SLOT_Active_2_start__ = 0x00000000;
define exported symbol  __ICFEDIT_SLOT_Active_2_end__   = 0x00000000;
define exported symbol  __ICFEDIT_SLOT_Active_3_header__= 0x00000000;
define exported symbol  __ICFEDIT_SLOT_Active_3_start__ = 0x00000000;
define exported symbol  __ICFEDIT_SLOT_Active_3_end__   = 0x00000000;
define exported symbol  __ICFEDIT_SLOT_Dwl_2_start__    = 0x00000000;
define exported symbol  __ICFEDIT_SLOT_Dwl_2_end__      = 0x00000000;
define exported symbol  __ICFEDIT_SLOT_Dwl_3_start__    = 0x00000000;
define exported symbol  __ICFEDIT_SLOT_Dwl_3_end__      = 0x00000000;
