/*###ICF### Set of symbols used in SE and SB_SFU projects ****/

/* Slots must be aligned on sectors */

/* swap (128 kbytes) */
define exported symbol  __ICFEDIT_SWAP_start__ = 0x08020000;
define exported symbol  __ICFEDIT_SWAP_end__   = 0x0803FFFF;

/* Active slot #1 (640 kbytes) */
define exported symbol  __ICFEDIT_SLOT_Active_1_start__ = 0x08040000;
define exported symbol  __ICFEDIT_SLOT_Active_1_end__   = 0x080DFFFF;
define exported symbol  __ICFEDIT_SLOT_Active_1_header__= __ICFEDIT_SLOT_Active_1_start__;

/* Dwl slot #1 (640 kbytes) */
define exported symbol  __ICFEDIT_SLOT_Dwl_1_start__= 0x080E0000;
define exported symbol  __ICFEDIT_SLOT_Dwl_1_end__  = 0x0817FFFF;

/* Slots not configured */
define exported symbol  __ICFEDIT_SLOT_Active_2_header__= 0x00000000;
define exported symbol  __ICFEDIT_SLOT_Active_2_start__ = 0x00000000;
define exported symbol  __ICFEDIT_SLOT_Active_2_end__   = 0x00000000;
define exported symbol  __ICFEDIT_SLOT_Active_3_header__= 0x00000000;
define exported symbol  __ICFEDIT_SLOT_Active_3_start__ = 0x00000000;
define exported symbol  __ICFEDIT_SLOT_Active_3_end__   = 0x00000000;
define exported symbol  __ICFEDIT_SLOT_Dwl_2_start__    = 0x00000000;
define exported symbol  __ICFEDIT_SLOT_Dwl_2_end__      = 0x00000000;
define exported symbol  __ICFEDIT_SLOT_Dwl_3_start__    = 0x00000000;
define exported symbol  __ICFEDIT_SLOT_Dwl_3_end__      = 0x00000000;

