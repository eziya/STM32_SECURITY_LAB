/*###ICF### Set of symbols used in SE and SB_SFU projects ****/

/* Slots must be aligned on 2048 bytes (0x800) */

/* Active slot #1 ( 32 Kbytes) */
define exported symbol  __ICFEDIT_SLOT_Active_1_start__ = 0x08008000;
define exported symbol  __ICFEDIT_SLOT_Active_1_end__   = 0x0800FFFF;
define exported symbol  __ICFEDIT_SLOT_Active_1_header__= __ICFEDIT_SLOT_Active_1_start__;

/* Slots not configured */
define exported symbol  __ICFEDIT_SLOT_Active_2_header__= 0x00000000;
define exported symbol  __ICFEDIT_SLOT_Active_2_start__ = 0x00000000;
define exported symbol  __ICFEDIT_SLOT_Active_2_end__   = 0x00000000;
define exported symbol  __ICFEDIT_SLOT_Active_3_header__= 0x00000000;
define exported symbol  __ICFEDIT_SLOT_Active_3_start__ = 0x00000000;
define exported symbol  __ICFEDIT_SLOT_Active_3_end__   = 0x00000000;
