/*###ICF### Set of symbols used in SE and SB_SFU projects ****/

/******************************************************************************/
/*                              ROM section                                   */
/******************************************************************************/

/* SE Code region protected by MPU isolation */
define exported symbol __ICFEDIT_SE_Code_region_ROM_start__       = 0x08000400;
define exported symbol __ICFEDIT_SE_CallGate_region_ROM_start__   = __ICFEDIT_SE_Code_region_ROM_start__ + 4;
define exported symbol __ICFEDIT_SE_CallGate_Region_ROM_End__     = __ICFEDIT_SE_Code_region_ROM_start__ + 0x1FF;

/* SE key region protected by MPU isolation */
define exported symbol __ICFEDIT_SE_Key_region_ROM_start__        = __ICFEDIT_SE_CallGate_Region_ROM_End__ + 1;
define exported symbol __ICFEDIT_SE_Key_region_ROM_end__          = __ICFEDIT_SE_Key_region_ROM_start__ + 0x2FF; /* H7: The minimum PCROP area that can be set is 16 Flash words, that is 512 bytes. */

/* SE Startup                               */
define exported symbol __ICFEDIT_SE_Startup_region_ROM_start__    = __ICFEDIT_SE_Key_region_ROM_end__ + 1;
define exported symbol __ICFEDIT_SE_Code_nokey_region_ROM_start__ = __ICFEDIT_SE_Startup_region_ROM_start__ + 0x100;
/* Aligned SE End at the end of the 1st 24Kbytes of flash, MPU protection isolation constraints */
define exported symbol __ICFEDIT_SE_Code_region_ROM_end__         = 0x08005FFF;

/* SE IF ROM: used to locate Secure Engine interface code out of MPU isolation     */
/*
 * We must be out of Region 2 to allow unprivileged access
 * With the current settings Region 2 starts from 0x08000000 and covers 24kB of code (0x6000)
 */
define exported symbol __ICFEDIT_SE_IF_region_ROM_start__         = 0x08000000 + 0x6000;
define exported symbol __ICFEDIT_SE_IF_region_ROM_end__           = __ICFEDIT_SE_IF_region_ROM_start__ + 0x6FF;

/* Secure memory activation code - initialization area */
define exported symbol __ICFEDIT_SB_HDP_region_ROM_start__        = __ICFEDIT_SE_IF_region_ROM_end__ + 1;
define exported symbol __ICFEDIT_SB_HDP_region_ROM_end__          = __ICFEDIT_SB_HDP_region_ROM_start__ + 0xFF;

/* SBSFU Code region */
define exported symbol __ICFEDIT_SB_region_ROM_start__            = __ICFEDIT_SB_HDP_region_ROM_end__ + 1;
define exported symbol __ICFEDIT_SB_region_ROM_end__              = __ICFEDIT_SB_region_ROM_start__ + 0x9FFF;

/* LOADER code region */
define exported symbol __ICFEDIT_LOADER_region_ROM_start__        = __ICFEDIT_SB_region_ROM_end__ + 1;
define exported symbol __ICFEDIT_LOADER_region_ROM_end__          = 0x08017FFF;

/* SECURE COUNTER region */
define exported symbol __ICFEDIT_SECURE_COUNTER_region_ROM_start__  = __ICFEDIT_LOADER_region_ROM_end__ + 1;
define exported symbol __ICFEDIT_SECURE_COUNTER_region_ROM_end__    = 0x0801FFFF;

/* ROM regions definition */
define region SE_Entry_Secure_ROM_Region = mem:[from __ICFEDIT_SE_Code_region_ROM_start__ to __ICFEDIT_SE_CallGate_Region_ROM_End__];
define region SE_Key_ROM_region          = mem:[from __ICFEDIT_SE_Key_region_ROM_start__ to __ICFEDIT_SE_Key_region_ROM_end__];
define region SE_ROM_region              = mem:[from __ICFEDIT_SE_Code_nokey_region_ROM_start__ to __ICFEDIT_SE_Code_region_ROM_end__];
define region SE_IF_ROM_region           = mem:[from __ICFEDIT_SE_IF_region_ROM_start__ to __ICFEDIT_SE_IF_region_ROM_end__];
define region SB_HDP_ROM_region          = mem:[from __ICFEDIT_SB_HDP_region_ROM_start__ to __ICFEDIT_SB_HDP_region_ROM_end__];
define region SB_ROM_region              = mem:[from __ICFEDIT_SB_region_ROM_start__ to __ICFEDIT_SB_region_ROM_end__];
define region LOADER_ROM_region          = mem:[from __ICFEDIT_LOADER_region_ROM_start__ to __ICFEDIT_LOADER_region_ROM_end__];

/******************************************************************************/
/*                              RAM section                                   */
/*                                                                            */
/******************************************************************************/

/* SE RAM region protected area */
define exported symbol __ICFEDIT_SE_region_RAM_start__      = 0x20000000;
define exported symbol __ICFEDIT_SE_region_RAM_stack_top__  = 0x20000400; /* Secure Engine's private stack */
define exported symbol __ICFEDIT_SE_region_RAM_end__        = 0x20000FFF;

/* Secure memory activation code area - execution in RAM */
define exported symbol __ICFEDIT_SB_HDP_Code_region_RAM_start__ = __ICFEDIT_SE_region_RAM_end__ + 1;
define exported symbol __ICFEDIT_SB_HDP_Code_region_RAM_end__   = __ICFEDIT_SB_HDP_Code_region_RAM_start__ + 0xFF;

/* LOADER communication region when bypass mode activated */
define exported symbol __ICFEDIT_LOADER_COM_region_RAM_start__  = __ICFEDIT_SB_HDP_Code_region_RAM_end__ + 1;
define exported symbol __ICFEDIT_LOADER_COM_region_RAM_end__    = __ICFEDIT_LOADER_COM_region_RAM_start__ + 0x0F;

/* SBSFU RAM region */
define exported symbol __ICFEDIT_SB_region_RAM_start__ = __ICFEDIT_LOADER_COM_region_RAM_end__ + 1;
define exported symbol __ICFEDIT_SB_region_RAM_end__   = 0x2001FFFF;

/* LOADER RAM region */
define exported symbol __ICFEDIT_LOADER_region_RAM_start__ = __ICFEDIT_LOADER_COM_region_RAM_end__ + 1;
define exported symbol __ICFEDIT_LOADER_region_RAM_end__   = 0x20013FFF;

/* User App LOADER : code execution from RAM */
define exported symbol __ICFEDIT_APP_LOADER_region_RAM_code_start__ = 0x20014000;
define exported symbol __ICFEDIT_APP_LOADER_region_RAM_code_end__   = 0x2001FFFF;

/* RAM regions definition */
define region SE_RAM_region               = mem:[from __ICFEDIT_SE_region_RAM_stack_top__ to __ICFEDIT_SE_region_RAM_end__];
define region LOADER_COM_RAM_region       = mem:[from __ICFEDIT_LOADER_COM_region_RAM_start__ to __ICFEDIT_LOADER_COM_region_RAM_end__];
define region SB_HDP_CODE_RAM_region      = mem:[from __ICFEDIT_SB_HDP_Code_region_RAM_start__ to __ICFEDIT_SB_HDP_Code_region_RAM_end__];
define region SB_RAM_region               = mem:[from __ICFEDIT_SB_region_RAM_start__ to __ICFEDIT_SB_region_RAM_end__];
define region LOADER_RAM_region 	      = mem:[from __ICFEDIT_LOADER_region_RAM_start__ to __ICFEDIT_LOADER_region_RAM_end__];
define region APP_LOADER_RAM_code_region  = mem:[from __ICFEDIT_APP_LOADER_region_RAM_code_start__ to __ICFEDIT_APP_LOADER_region_RAM_code_end__];
