/*###ICF### Set of symbols used in SE and SB_SFU projects ****/

/* Slots must be aligned on sector size */

/* Swap in external memory : 128 kbytes */
define exported symbol  __ICFEDIT_SWAP_start__ = 0x90800000;
define exported symbol  __ICFEDIT_SWAP_end__   = 0x9081FFFF;

/* Active slot #1 in external memory : 4 Mbytes */
define exported symbol  __ICFEDIT_SLOT_Active_1_header__= 0x90000000;
define exported symbol  __ICFEDIT_SLOT_Active_1_start__ = 0x90000000;
define exported symbol  __ICFEDIT_SLOT_Active_1_end__   = 0x903FFFFF;
/* APP LOADER code located inside Active slot 1
   with execution from RAM to be able to download new image inside external flash
   First 0x800 bytes reserved for header + vector table */
define exported symbol __ICFEDIT_APP_LOADER_region_ROM_start__  = 0x90000800;
define exported symbol __ICFEDIT_APP_LOADER_region_ROM_end__    = 0x90006FFF;

/* Dwl slot #1 in external memory : 4 Mbytes */
define exported symbol  __ICFEDIT_SLOT_Dwl_1_start__= 0x90400000;
define exported symbol  __ICFEDIT_SLOT_Dwl_1_end__  = 0x907FFFFF;

/* Slots not configured */
define exported symbol  __ICFEDIT_SLOT_Active_2_header__= 0x00000000;
define exported symbol  __ICFEDIT_SLOT_Active_2_start__ = 0x00000000;
define exported symbol  __ICFEDIT_SLOT_Active_2_end__   = 0x00000000;
define exported symbol  __ICFEDIT_SLOT_Active_3_header__= 0x00000000;
define exported symbol  __ICFEDIT_SLOT_Active_3_start__ = 0x00000000;
define exported symbol  __ICFEDIT_SLOT_Active_3_end__   = 0x00000000;
define exported symbol  __ICFEDIT_SLOT_Dwl_2_start__    = 0x00000000;
define exported symbol  __ICFEDIT_SLOT_Dwl_2_end__      = 0x00000000;
define exported symbol  __ICFEDIT_SLOT_Dwl_3_start__    = 0x00000000;
define exported symbol  __ICFEDIT_SLOT_Dwl_3_end__      = 0x00000000;
