/**
  ******************************************************************************
  * @file    main.c
  * @author  MCD Application Team
  * @brief   Main program body
  ******************************************************************************
  * @attention
  *
  * Copyright (c) 2016 STMicroelectronics.
  * All rights reserved.
  *
  * This software is licensed under terms that can be found in the LICENSE file
  * in the root directory of this software component.
  * If no LICENSE file comes with this software, it is provided AS-IS.
  *
  ******************************************************************************
  */

/* USER CODE END Header */

/* Includes ------------------------------------------------------------------*/
#include "main.h"
#include "mbedtls/ecdsa.h"
#include "mbedtls/x509_crt.h"
#include "mbedtls/sha256.h"
#include "stsafea_conf.h"
#include "stsafea_core.h"
#include "stsafea_crypto.h"

/* Private includes ----------------------------------------------------------*/
/* USER CODE BEGIN Includes */

#include "HAL_STSAFE-Axx.h"
#if defined(__ICCARM__)
#include <LowLevelIOInterface.h>
#endif /* __ICCARM__ */

/* USER CODE END Includes */

/* Private typedef -----------------------------------------------------------*/
/* USER CODE BEGIN PTD */

/* USER CODE END PTD */

/* Private define ------------------------------------------------------------*/
/* USER CODE BEGIN PD */

/* USER CODE END PD */

/* Private macro -------------------------------------------------------------*/
/* USER CODE BEGIN PM */

/* USER CODE END PM */

/* Private variables ---------------------------------------------------------*/

UART_HandleTypeDef huart1;

/* USER CODE BEGIN PV */

/* USER CODE END PV */

/* Private function prototypes -----------------------------------------------*/
void SystemClock_Config(void);

static void MX_USART1_UART_Init(void);
/* USER CODE BEGIN PFP */

/* USER CODE END PFP */

/* Private user code ---------------------------------------------------------*/
/* USER CODE BEGIN 0 */

/* USER CODE END 0 */

/**
  * @brief  The application entry point.
  * @retval uint8_t
  */
int main(void)
{
  /* USER CODE BEGIN 1 */

  /* USER CODE END 1 */

  /* MCU Configuration--------------------------------------------------------*/

  /* Reset of all peripherals, Initializes the Flash interface and the Systick. */
  HAL_Init();

  /* USER CODE BEGIN Init */

  /* USER CODE END Init */

  /* Configure the system clock */
  SystemClock_Config();

  /* USER CODE BEGIN SysInit */

  /* USER CODE END SysInit */

  /* Initialize all configured peripherals */

  MX_USART1_UART_Init();

  /* USER CODE BEGIN 2 */

  /* CERT_CA_FIRMWARE */
  /* sbsfu_r0_crt.der */
  static uint8_t CERT_CA_FW [] = { 0x30,0x82,0x1,0xf5,0x30,0x82,0x1,0x9a,0xa0,0x3,0x2,0x1,0x2,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0xde,0x38};


  /* CERT_CA_OEM_FIRMWARE */
  /* sbsfu_inter1_oem1_crt.der */
  static uint8_t CERT_CA_OEM_FW [] = { 0x30,0x82,0x1,0xe7,0x30,0x82,0x1,0x8e,0xa0,0x3,0x2,0x1,0x2,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0x82,0x73};

#ifdef READ_CERTIFICATE_AND_VERIFY
  uint8_t Zone_Out_Cert_CA[sizeof(CERT_CA_FW)];
  uint8_t Zone_Out_Cert_CA_OEM[sizeof(CERT_CA_OEM_FW)];
#endif /* TEST_VERIFY_CERTIFICATE_WRITING */

  StSafeA_Handle_t   stsafea_handle;
  uint8_t a_rx_tx_stsafea_data [STSAFEA_BUFFER_MAX_SIZE];
  uint8_t StatusCode = OK;

  printf("\r\n-------------------------------------------------------------------------------\n");
  printf("Start provisioning of STSAFE-A \r\n");

  STS_CHK(StatusCode, StSafeA_Init(&stsafea_handle, a_rx_tx_stsafea_data));

  if (!StatusCode)
  {
    STS_CHK(StatusCode, Init_HAL(&stsafea_handle))

    if ((!StatusCode) || (StatusCode == STSAFEA_KEY_NOT_FOUND))
    {
#ifdef FORCE_PAIRING
      StatusCode = STSAFEA_KEY_NOT_FOUND;
      printf("\r\nForce STSAFE-A provisioning\r\n");
#endif /* FORCE_PAIRING */

      if (StatusCode == STSAFEA_KEY_NOT_FOUND)
      {
        printf("\r\nLaunching STSAFE-A pairing\r\n");

        if (Init_Perso(&stsafea_handle, DEFAULT_KEYS, NULL) == OK)
        {
          printf("Pairing OK \r\n");
          StSafeA_HostKeys_Init();
        }
        else
        {
          printf("Please check User configuration, Option Byte DBANK must be DBANK=0  \r\n");
          printf("Pairing NOK, End of Provisioning \r\n");
          while(1);

        }
      }

#ifdef ERASE_CERTIFICATE_BEFORE_UPDATE

      printf("\r\nErase Data : ");

      if (HAL_Erase_Data_Zone(&stsafea_handle, ZONE_CERT_CA_FIRMW, sizeof(CERT_CA_FW), 0) == 0
          && HAL_Erase_Data_Zone(&stsafea_handle, ZONE_CERT_OEM_FIRMW, sizeof(CERT_CA_OEM_FW), 0) == 0)
      {
        printf("OK \r\n");
      }
      else
      {
        printf("Erase data NOK, to understand source of the error please enable log \r\nusing #define PRINTF_ON, End of Provisioning !!!! \r\n");
        while(1);

      }

#endif /* ERASE_CERTIFICATE_BEFORE_UPDATE */

      /* Writing of STM_POC_SBSFU_ROOT_TEST_CA_00 */

      printf("\r\nNow Store Certificate STM_POC_SBSFU_ROOT_TEST_CA_00 inside STSAFE-A \r\n");

      if (HAL_Store_Data_Zone(&stsafea_handle, ZONE_CERT_CA_FIRMW, sizeof(CERT_CA_FW), CERT_CA_FW, 0) == OK)
      {
        printf("Certificate STM_POC_SBSFU_ROOT_TEST_CA_00 successfully written inside STSAFE-A : OK\r\n");
      }
      else
      {
        printf("Store Data NOK, to understand source of the error please enable log \r\nusing #define PRINTF_ON, End of Provisioning !!!! \r\n");
        while(1);
      }

      /* Writing of STM_POC_SBSFU_OEM_TEST_CA_00  */

      printf("\r\nNow Store Certificate  STM_POC_SBSFU_OEM_TEST_CA_00 inside STSAFE-A \r\n");


      if (HAL_Store_Data_Zone(&stsafea_handle, ZONE_CERT_OEM_FIRMW, sizeof(CERT_CA_OEM_FW), CERT_CA_OEM_FW, 0) == OK)
      {
        printf("Certificate STM_POC_SBSFU_OEM_TEST_CA_00 successfully written inside STSAFE-A : OK\r\n");
      }
      else
      {
        printf("Store Data NOK, to understand source of the error please enable log \r\nusing #define PRINTF_ON, End of Provisioning !!!! \r\n");
        while(1);
      }

#ifdef READ_CERTIFICATE_AND_VERIFY

      printf("\r\nNow reading and compare Certificates written inside STSAFE-A :\r\n\r\n");

      if (HAL_Get_Data_Zone(&stsafea_handle,ZONE_CERT_CA_FIRMW,sizeof(CERT_CA_FW), Zone_Out_Cert_CA,0)==OK)
      {
        printf("Get Certificate CERT_CA_FW OK \r\n");
      }
      else
      {
        printf("Get Certificate fail \r\n");
        while(1);
      }

      if (!StatusCode && memcmp(CERT_CA_FW, Zone_Out_Cert_CA, sizeof(CERT_CA_FW)))
      {

        printf("Certificate not equals expected data \r\n");
        while(1);
      }
      else
      {
        printf("Certificate CERT_CA_FW successfully read and compared : OK\r\n");
      }

      if (HAL_Get_Data_Zone(&stsafea_handle,ZONE_CERT_OEM_FIRMW,sizeof(CERT_CA_OEM_FW), Zone_Out_Cert_CA_OEM,0)==OK)
      {
        printf("Get Certificate CERT_CA_OEM_FW OK \r\n");
      }
      else
      {
        printf("Get Certificate fail \r\n");
        while(1);
      }

      if (!StatusCode && memcmp(CERT_CA_OEM_FW, Zone_Out_Cert_CA_OEM, sizeof(CERT_CA_OEM_FW)))
      {
        printf("Certificate not equals expected data \r\n");
      }
      else
      {
        printf("Certificate CERT_CA_OEM_FW successfully read and compared : OK \r\n");

      }

#endif /* READ_CERTIFICATE_AND_VERIFY */

      printf("\r\nEnd provisioning of STSAFE-A \r\n");

    }
    else
    {
      printf("\r\nProblem while initialization of STSAFE-Axx secure storage API\n");
    }

  } /* if (!StatusCode)*/
  else
  {
    printf("\r\nProblem while initialization of STSAFE-Axx\n");
  }


  /* USER CODE END 2 */

  /* Infinite loop */
  /* USER CODE BEGIN WHILE */
  while (1)
  {
    /* USER CODE END WHILE */

    /* USER CODE BEGIN 3 */
  }
  /* USER CODE END 3 */
}


/**
  * @brief System Clock Configuration
  * @retval None
  */
void SystemClock_Config(void)
{
  RCC_OscInitTypeDef RCC_OscInitStruct = {0};
  RCC_ClkInitTypeDef RCC_ClkInitStruct = {0};
  RCC_PeriphCLKInitTypeDef PeriphClkInit = {0};

  /**Initializes the CPU, AHB and APB busses clocks
  */
  RCC_OscInitStruct.OscillatorType = RCC_OSCILLATORTYPE_MSI;
  RCC_OscInitStruct.MSIState = RCC_MSI_ON;
  RCC_OscInitStruct.MSICalibrationValue = 0;
  RCC_OscInitStruct.MSIClockRange = RCC_MSIRANGE_6;
  RCC_OscInitStruct.PLL.PLLState = RCC_PLL_ON;
  RCC_OscInitStruct.PLL.PLLSource = RCC_PLLSOURCE_MSI;
  RCC_OscInitStruct.PLL.PLLM = 1;
  RCC_OscInitStruct.PLL.PLLN = 40;
  RCC_OscInitStruct.PLL.PLLP = RCC_PLLP_DIV7;
  RCC_OscInitStruct.PLL.PLLQ = RCC_PLLQ_DIV2;
  RCC_OscInitStruct.PLL.PLLR = RCC_PLLR_DIV2;
  if (HAL_RCC_OscConfig(&RCC_OscInitStruct) != HAL_OK)
  {
    Error_Handler();
  }
  /**Initializes the CPU, AHB and APB busses clocks
  */
  RCC_ClkInitStruct.ClockType = RCC_CLOCKTYPE_HCLK | RCC_CLOCKTYPE_SYSCLK
                                | RCC_CLOCKTYPE_PCLK1 | RCC_CLOCKTYPE_PCLK2;
  RCC_ClkInitStruct.SYSCLKSource = RCC_SYSCLKSOURCE_PLLCLK;
  RCC_ClkInitStruct.AHBCLKDivider = RCC_SYSCLK_DIV1;
  RCC_ClkInitStruct.APB1CLKDivider = RCC_HCLK_DIV1;
  RCC_ClkInitStruct.APB2CLKDivider = RCC_HCLK_DIV1;

  if (HAL_RCC_ClockConfig(&RCC_ClkInitStruct, FLASH_LATENCY_4) != HAL_OK)
  {
    Error_Handler();
  }

  if (HAL_RCCEx_PeriphCLKConfig(&PeriphClkInit) != HAL_OK)
  {
    Error_Handler();
  }
  /**Configure the main internal regulator output voltage
  */
  if (HAL_PWREx_ControlVoltageScaling(PWR_REGULATOR_VOLTAGE_SCALE1) != HAL_OK)
  {
    Error_Handler();
  }
}

/**
  * @brief USART1 Initialization Function
  * @param None
  * @retval None
  */
static void MX_USART1_UART_Init(void)
{
  /* USER CODE END USART1_Init 1 */
  huart1.Instance = USART1;
  huart1.Init.BaudRate = UART_SPEED;
  huart1.Init.WordLength = UART_WORDLENGTH_8B;
  huart1.Init.StopBits = UART_STOPBITS_1;
  huart1.Init.Parity = UART_PARITY_NONE;
  huart1.Init.Mode = UART_MODE_TX_RX;
  huart1.Init.HwFlowCtl = UART_HWCONTROL_NONE;
  huart1.Init.OverSampling = UART_OVERSAMPLING_16;
  huart1.Init.OneBitSampling = UART_ONE_BIT_SAMPLE_DISABLE;
  huart1.AdvancedInit.AdvFeatureInit = UART_ADVFEATURE_NO_INIT;
  if (HAL_UART_Init(&huart1) != HAL_OK)
  {
    Error_Handler();
  }
}

#if (defined(__GNUC__) && !defined(__CC_ARM) && !defined(__ARMCC_VERSION))
/* With GCC/RAISONANCE, small printf (option LD Linker->Libraries->Small printf
   set to 'Yes') calls __io_putchar() */

#define PUTCHAR_PROTOTYPE int __io_putchar(int ch)
#define GETCHAR_PROTOTYPE int __io_getchar(void)
#elif defined(__ICCARM__)
/* New definition from EWARM V9, compatible with EWARM8 */
int iar_fputc(int ch);
#define PUTCHAR_PROTOTYPE int iar_fputc(int ch)
#else
#define PUTCHAR_PROTOTYPE int fputc(int ch, FILE *f)
#define GETCHAR_PROTOTYPE int fgetc(FILE *f)

#endif /* __GNUC__ */

/**
  * @brief  Retargets the C library __write function to the IAR function iar_fputc.
  * @param  file: file descriptor.
  * @param  ptr: pointer to the buffer where the data is stored.
  * @param  len: length of the data to write in bytes.
  * @retval length of the written data in bytes.
  */
#if defined(__ICCARM__)
size_t __write(int file, unsigned char const *ptr, size_t len)
{
  size_t idx;
  unsigned char const *pdata = ptr;

  for (idx = 0; idx < len; idx++)
  {
    iar_fputc((int)*pdata);
    pdata++;
  }
  return len;
}
#endif /* __ICCARM__ */

/**
  * @brief  Retargets the C library printf function to the USART.
  * @param  None
  * @retval None
  */
PUTCHAR_PROTOTYPE
{
  /* Place your implementation of fputc here */
  /* e.g. write a character to the USART2 and Loop until the end of transmission */
  while (HAL_OK != HAL_UART_Transmit(&huart1, (uint8_t *) &ch, 1, 30000))
  {
    ;
  }
  return ch;
}
/**
  * @brief  Retargets the C library scanf function to the USART.
  * @param  None
  * @retval None
  */
GETCHAR_PROTOTYPE
{
  /* Place your implementation of fgetc here */
  /* e.g. readwrite a character to the USART2 and Loop until the end of transmission */
  uint8_t ch = 0;
  while (HAL_OK != HAL_UART_Receive(&huart1, (uint8_t *)&ch, 1, 30000))
  {
    ;
  }
  return ch;
}

/* USER CODE BEGIN 4 */

/* USER CODE END 4 */

/**
  * @brief  This function is executed in case of error occurrence.
  * @retval None
  */
void Error_Handler(void)
{
  /* USER CODE BEGIN Error_Handler_Debug */
  /* User can add his own implementation to report the HAL error return state */

  /* USER CODE END Error_Handler_Debug */
}

#ifdef  USE_FULL_ASSERT
/**
  * @brief  Reports the name of the source file and the source line number
  *         where the assert_param error has occurred.
  * @param  file: pointer to the source file name
  * @param  line: assert_param error line source number
  * @retval None
  */
void assert_failed(char *file, uint32_t line)
{
  /* USER CODE BEGIN 6 */
  /* User can add his own implementation to report the file name and line number,
     tex: printf("Wrong parameters value: file %s on line %d\r\n", file, line) */
  /* USER CODE END 6 */
}
#endif /* USE_FULL_ASSERT */
