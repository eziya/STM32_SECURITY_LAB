/*###ICF### Set of symbols used in SE and SB_SFU projects ****/

/* Slots Regions must be aligned on 8192 bytes (0x2000) */

/* swap region (32 kbytes) */
define exported symbol  __ICFEDIT_SWAP_start__  = 0x08110000;
define exported symbol  __ICFEDIT_SWAP_end__    = 0x08117FFF;

/* Active slot #1 (896 kbytes) */
define exported symbol  __ICFEDIT_SLOT_Active_1_header__= 0x0811E000;
define exported symbol  __ICFEDIT_SLOT_Active_1_start__ = 0x08120000;
define exported symbol  __ICFEDIT_SLOT_Active_1_end__   = 0x081FFFFF;

/* Dwl slot #1 (896 kbytes) */
define exported symbol  __ICFEDIT_SLOT_Dwl_1_start__    = 0x08030000;
define exported symbol  __ICFEDIT_SLOT_Dwl_1_end__      = 0x0810FFFF;

/* Slots not configured */
define exported symbol  __ICFEDIT_SLOT_Dwl_2_start__    = 0x00000000;
define exported symbol  __ICFEDIT_SLOT_Dwl_2_end__      = 0x00000000;
define exported symbol  __ICFEDIT_SLOT_Dwl_3_start__    = 0x00000000;
define exported symbol  __ICFEDIT_SLOT_Dwl_3_end__      = 0x00000000;
define exported symbol  __ICFEDIT_SLOT_Active_2_header__= 0x00000000;
define exported symbol  __ICFEDIT_SLOT_Active_2_start__ = 0x00000000;
define exported symbol  __ICFEDIT_SLOT_Active_2_end__   = 0x00000000;
define exported symbol  __ICFEDIT_SLOT_Active_3_header__= 0x00000000;
define exported symbol  __ICFEDIT_SLOT_Active_3_start__ = 0x00000000;
define exported symbol  __ICFEDIT_SLOT_Active_3_end__   = 0x00000000;

