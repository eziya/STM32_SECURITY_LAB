/*###ICF### Set of symbols used in SE and SB_SFU projects ****/

/* Slots must be aligned on sector size */

/* Swap sector in sector 0 of Bank2 : 128 kbytes */
define exported symbol  __ICFEDIT_SWAP_start__ = 0x08100000;
define exported symbol  __ICFEDIT_SWAP_end__   = 0x0811FFFF;

/* Active slot #1 in Sector 1 to 7 of Bank1; 7 x 128 kbytes */
define exported symbol  __ICFEDIT_SLOT_Active_1_start__ = 0x08020000;
define exported symbol  __ICFEDIT_SLOT_Active_1_end__   = 0x080FFFFF;
define exported symbol  __ICFEDIT_SLOT_Active_1_header__= __ICFEDIT_SLOT_Active_1_start__;

/* Dwl slot #1 in sector 1 to 7 of Bank2 : 7 * 128 kbytes */
define exported symbol  __ICFEDIT_SLOT_Dwl_1_start__= 0x08120000;
define exported symbol  __ICFEDIT_SLOT_Dwl_1_end__  = 0x081FFFFF;

/* Slots not configured */
define exported symbol  __ICFEDIT_SLOT_Active_2_header__= 0x00000000;
define exported symbol  __ICFEDIT_SLOT_Active_2_start__ = 0x00000000;
define exported symbol  __ICFEDIT_SLOT_Active_2_end__   = 0x00000000;
define exported symbol  __ICFEDIT_SLOT_Active_3_header__= 0x00000000;
define exported symbol  __ICFEDIT_SLOT_Active_3_start__ = 0x00000000;
define exported symbol  __ICFEDIT_SLOT_Active_3_end__   = 0x00000000;
define exported symbol  __ICFEDIT_SLOT_Dwl_2_start__    = 0x00000000;
define exported symbol  __ICFEDIT_SLOT_Dwl_2_end__      = 0x00000000;
define exported symbol  __ICFEDIT_SLOT_Dwl_3_start__    = 0x00000000;
define exported symbol  __ICFEDIT_SLOT_Dwl_3_end__      = 0x00000000;

