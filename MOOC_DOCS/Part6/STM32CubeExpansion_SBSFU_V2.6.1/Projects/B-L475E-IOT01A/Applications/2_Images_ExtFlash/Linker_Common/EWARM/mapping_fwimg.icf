/*###ICF### Set of symbols used in SE and SB_SFU projects ****/

/* Slots must be aligned on 2048 bytes (0x800) */

/* Active slot #1 (472 kbytes) */
/* Header does not start at the beginning of the sector to ensure the overlap constraint between
   firewall NVDATA section and firewall CODE section.
   This constraint is relevant only for products with dual bank and firewall isolation */
define exported symbol  __ICFEDIT_SLOT_Active_1_header__= 0x08089E00;
define exported symbol  __ICFEDIT_SLOT_Active_1_start__= 0x0808A000;
define exported symbol  __ICFEDIT_SLOT_Active_1_end__  = 0x080FFFFF;

/* Dwl slot #1 (472 kbytes) */
define exported symbol  __ICFEDIT_SLOT_Dwl_1_start__= 0x90000000;
define exported symbol  __ICFEDIT_SLOT_Dwl_1_end__  = 0x90075FFF;

/* Active slot #2 (432 kbytes) */
define exported symbol  __ICFEDIT_SLOT_Active_2_header__= 0x08089000;
define exported symbol  __ICFEDIT_SLOT_Active_2_start__ = 0x08014000;
define exported symbol  __ICFEDIT_SLOT_Active_2_end__   = 0x0807FFFF;

/* Dwl slot #2 (432 kbytes) */
define exported symbol  __ICFEDIT_SLOT_Dwl_2_start__= 0x90080000;
define exported symbol  __ICFEDIT_SLOT_Dwl_2_end__  = 0x900EBFFF;

/* Slots not configured */
define exported symbol  __ICFEDIT_SLOT_Active_3_header__= 0x00000000;
define exported symbol  __ICFEDIT_SLOT_Active_3_start__ = 0x00000000;
define exported symbol  __ICFEDIT_SLOT_Active_3_end__   = 0x00000000;
define exported symbol  __ICFEDIT_SLOT_Dwl_3_start__    = 0x00000000;
define exported symbol  __ICFEDIT_SLOT_Dwl_3_end__      = 0x00000000;

/* SWAP installation feature not allowed in this example in order to keep dwl slot encrypted */
define exported symbol  __ICFEDIT_SWAP_start__          = 0x00000000;
define exported symbol  __ICFEDIT_SWAP_end__            = 0x00000000;
