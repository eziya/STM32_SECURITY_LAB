/*###ICF### Set of symbols used in SE and SB_SFU projects ****/

/******************************************************************************/
/*                              ROM section                                   */
/******************************************************************************/

/* SE Code region protected by firewall */
define exported symbol __ICFEDIT_SE_Code_region_ROM_start__       = 0x08000200;
define exported symbol __ICFEDIT_SE_CallGate_region_ROM_start__   = __ICFEDIT_SE_Code_region_ROM_start__ + 4;
define exported symbol __ICFEDIT_SE_CallGate_Region_ROM_End__     = __ICFEDIT_SE_Code_region_ROM_start__ + 0x1FF;

/* SE Startup: call before enabling firewall                                  */
define exported symbol __ICFEDIT_SE_Startup_region_ROM_start__    = __ICFEDIT_SE_CallGate_Region_ROM_End__ + 1;
define exported symbol __ICFEDIT_SE_Code_nokey_region_ROM_start__ = __ICFEDIT_SE_Startup_region_ROM_start__ + 0x100;
define exported symbol __ICFEDIT_SE_Code_region_ROM_end__         = __ICFEDIT_SE_Startup_region_ROM_start__ + 0xC0FF;

/* SE IF ROM: used to locate Secure Engine interface code out of firewall     */
define exported symbol __ICFEDIT_SE_IF_region_ROM_start__         = __ICFEDIT_SE_Code_region_ROM_end__ + 1;
define exported symbol __ICFEDIT_SE_IF_region_ROM_end__           = __ICFEDIT_SE_IF_region_ROM_start__ + 0x7FF;

/* SBSFU Code region */
define exported symbol __ICFEDIT_SB_region_ROM_start__            = __ICFEDIT_SE_IF_region_ROM_end__ + 1;
define exported symbol __ICFEDIT_SB_region_ROM_end__              = 0x08015FFF;

/* KMS Data Storage (NVMS) region protected by firewall */
/* In Dual Bank configuration, we propose to set it up to the next sector after beginning of the second bank */
/* First sector of second bank not used to ensure firewal protection in case of bank swap */
/* KMS Data Storage need for 2 images : 6 kbytes * 2 ==> 12 kbytes */
define exported symbol __ICFEDIT_KMS_DataStorage_start__          = 0x08080800;
define exported symbol __ICFEDIT_KMS_DataStorage_end__            = 0x080837FF;



/* ROM regions definition : ordered  */
define region SE_Entry_Secure_ROM_Region = mem:[from __ICFEDIT_SE_Code_region_ROM_start__ to __ICFEDIT_SE_CallGate_Region_ROM_End__];
define region SE_ROM_region              = mem:[from __ICFEDIT_SE_Code_nokey_region_ROM_start__ to __ICFEDIT_SE_Code_region_ROM_end__];
define region SE_IF_ROM_region           = mem:[from __ICFEDIT_SE_IF_region_ROM_start__ to __ICFEDIT_SE_IF_region_ROM_end__];
define region SB_ROM_region              = mem:[from __ICFEDIT_SB_region_ROM_start__ to __ICFEDIT_SB_region_ROM_end__];
define region KMS_DataStorage            = mem:[from __ICFEDIT_KMS_DataStorage_start__ to __ICFEDIT_KMS_DataStorage_end__];

/******************************************************************************/
/*                              RAM section                                   */
/*                                                                            */
/******************************************************************************/

/* SE RAM1 region protected by firewall */
/* SE stack is placed 1st in RAM, stack overflow does not write on other RAM area */
define exported symbol __ICFEDIT_SE_region_RAM_start__     = 0x20000000;
define exported symbol __ICFEDIT_SE_region_RAM_stack_top__ = 0x20000600; /* Secure Engine's private stack */
define exported symbol __ICFEDIT_SE_region_RAM_end__       = 0x20002BFF;

/* SBSFU RAM1 region */
define exported symbol __ICFEDIT_SB_region_RAM_start__ = __ICFEDIT_SE_region_RAM_end__ + 1;
define exported symbol __ICFEDIT_SB_region_RAM_end__   = 0x20017FFF;

/* RAM regions definition */
define region SE_RAM_region    = mem:[from __ICFEDIT_SE_region_RAM_stack_top__ to __ICFEDIT_SE_region_RAM_end__];
define region SB_RAM_region    = mem:[from __ICFEDIT_SB_region_RAM_start__ to __ICFEDIT_SB_region_RAM_end__];
