/*###ICF### Set of symbols used in SE and SB_SFU projects ****/

/* Slots must be aligned on 2048 bytes (0x800) */

/* swap (8 kbytes) */
define exported symbol  __ICFEDIT_SWAP_start__  = 0x080F6000;
define exported symbol  __ICFEDIT_SWAP_end__    = 0x080F7FFF;

/* Active slot #1 (408 kbytes) */
define exported symbol  __ICFEDIT_SLOT_Active_1_header__= 0x0808F000;
define exported symbol  __ICFEDIT_SLOT_Active_1_start__ = 0x08090000;
define exported symbol  __ICFEDIT_SLOT_Active_1_end__   = 0x080F5FFF;

/* Dwl slot #1 (408 kbytes) */
define exported symbol  __ICFEDIT_SLOT_Dwl_1_start__= 0x0801A000;
define exported symbol  __ICFEDIT_SLOT_Dwl_1_end__  = 0x0807FFFF;

/* Slots not configured */
define exported symbol  __ICFEDIT_SLOT_Active_2_header__= 0x00000000;
define exported symbol  __ICFEDIT_SLOT_Active_2_start__ = 0x00000000;
define exported symbol  __ICFEDIT_SLOT_Active_2_end__   = 0x00000000;
define exported symbol  __ICFEDIT_SLOT_Active_3_header__= 0x00000000;
define exported symbol  __ICFEDIT_SLOT_Active_3_start__ = 0x00000000;
define exported symbol  __ICFEDIT_SLOT_Active_3_end__   = 0x00000000;
define exported symbol  __ICFEDIT_SLOT_Dwl_2_start__    = 0x00000000;
define exported symbol  __ICFEDIT_SLOT_Dwl_2_end__      = 0x00000000;
define exported symbol  __ICFEDIT_SLOT_Dwl_3_start__    = 0x00000000;
define exported symbol  __ICFEDIT_SLOT_Dwl_3_end__      = 0x00000000;

