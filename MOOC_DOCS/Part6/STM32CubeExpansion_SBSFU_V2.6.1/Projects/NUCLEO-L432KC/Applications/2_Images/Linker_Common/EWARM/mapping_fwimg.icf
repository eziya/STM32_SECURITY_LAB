/*###ICF### Set of symbols used in SE and SB_SFU projects ****/

/* Slots must be aligned on 2048 bytes (0x800) */

/* swap (4 Kbytes) */
define exported symbol  __ICFEDIT_SWAP_start__  = 0x0800F000;
define exported symbol  __ICFEDIT_SWAP_end__    = 0x0800FFFF;

/* Active slot #1 (96 Kbytes) */
define exported symbol  __ICFEDIT_SLOT_Active_1_start__ = 0x08010000;
define exported symbol  __ICFEDIT_SLOT_Active_1_end__   = 0x08027FFF;
define exported symbol  __ICFEDIT_SLOT_Active_1_header__= __ICFEDIT_SLOT_Active_1_start__;

/* Dwl slot #1 (96 Kbytes) */
define exported symbol  __ICFEDIT_SLOT_Dwl_1_start__= 0x08028000;
define exported symbol  __ICFEDIT_SLOT_Dwl_1_end__  = 0x0803FFFF;

/* Slots not configured */
define exported symbol  __ICFEDIT_SLOT_Active_2_header__= 0x00000000;
define exported symbol  __ICFEDIT_SLOT_Active_2_start__ = 0x00000000;
define exported symbol  __ICFEDIT_SLOT_Active_2_end__   = 0x00000000;
define exported symbol  __ICFEDIT_SLOT_Active_3_header__= 0x00000000;
define exported symbol  __ICFEDIT_SLOT_Active_3_start__ = 0x00000000;
define exported symbol  __ICFEDIT_SLOT_Active_3_end__   = 0x00000000;
define exported symbol  __ICFEDIT_SLOT_Dwl_2_start__    = 0x00000000;
define exported symbol  __ICFEDIT_SLOT_Dwl_2_end__      = 0x00000000;
define exported symbol  __ICFEDIT_SLOT_Dwl_3_start__    = 0x00000000;
define exported symbol  __ICFEDIT_SLOT_Dwl_3_end__      = 0x00000000;

