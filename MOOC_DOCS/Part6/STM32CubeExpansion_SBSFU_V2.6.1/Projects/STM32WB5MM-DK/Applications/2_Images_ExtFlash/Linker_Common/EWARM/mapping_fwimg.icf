/*###ICF### Set of symbols used in SE and SB_SFU projects ****/

/* Slots must be aligned on 4096 bytes (0x1000) */

/* Active slot #1 (424 Kbytes) */
define exported symbol  __ICFEDIT_SLOT_Active_1_start__ = 0x08017000;
define exported symbol  __ICFEDIT_SLOT_Active_1_end__   = 0x0807FFFF;
define exported symbol  __ICFEDIT_SLOT_Active_1_header__= 0x08016000;

/* Dwl slot #1 (448 KBytes, that is to say seven 64-KBytes blocks) */
define exported symbol  __ICFEDIT_SLOT_Dwl_1_start__= 0x90000000;
define exported symbol  __ICFEDIT_SLOT_Dwl_1_end__  = 0x9006FFFF;

/* Backup (448 Kbytes, that is to say seven 64-KBytes blocks) */
define exported symbol  __ICFEDIT_BACKUP_start__  = 0x90070000;
define exported symbol  __ICFEDIT_BACKUP_end__    = 0x900DFFFF;

/* Slots not configured */
define exported symbol  __ICFEDIT_SLOT_Active_2_header__= 0x00000000;
define exported symbol  __ICFEDIT_SLOT_Active_2_start__ = 0x00000000;
define exported symbol  __ICFEDIT_SLOT_Active_2_end__   = 0x00000000;
define exported symbol  __ICFEDIT_SLOT_Active_3_header__= 0x00000000;
define exported symbol  __ICFEDIT_SLOT_Active_3_start__ = 0x00000000;
define exported symbol  __ICFEDIT_SLOT_Active_3_end__   = 0x00000000;
define exported symbol  __ICFEDIT_SLOT_Dwl_2_start__    = 0x00000000;
define exported symbol  __ICFEDIT_SLOT_Dwl_2_end__      = 0x00000000;
define exported symbol  __ICFEDIT_SLOT_Dwl_3_start__    = 0x00000000;
define exported symbol  __ICFEDIT_SLOT_Dwl_3_end__      = 0x00000000;

/* SWAP installation feature not allowed in this example in order to keep dwl slot encrypted */
define exported symbol  __ICFEDIT_SWAP_start__          = 0x00000000;
define exported symbol  __ICFEDIT_SWAP_end__            = 0x00000000;